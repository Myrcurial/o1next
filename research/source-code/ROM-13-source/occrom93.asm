	TITLE	'OSBORNE 1 UTILITY ROUTINES.'
NMOUT:
PBBH:
	;PRINT BINARY BYTE IN HEX.
;	CONVERTS THE 8 BIT, UNSIGNED INTEGER IN THE
;	A REGISTER INTO 2 ASCII CHARACTERS.
;	ENTRY	A= 8 BIT INTEGER
;	EXIT	NONE
;	CALLS	CO,PRVAL
; DESTROYS: AF, C.

	PUSH	AF	;SAVE ARGUMENT
	RRC
	RRC
	RRC
	RRC		;GET UPPER 4 BITS TO LOW 4 BIT POSITIONS
	CALL	PRVAL	;CONVERT LOWER 4 BITS TO ASCII
	CALL	CO	;SEND TO TERMINAL
	POP	AF	;GET BACK ARGUMENT
	CALL	PRVAL
	JMP	CO
	SPACE	4,10
PRVAL:
	;CONVERTS A NUMBER IN THE RANGE 0 TO F HEX TO
;	THE CORRESPONDING ASCII CHARACTER, 0-9,A-F.  PRVAL
;	DOES NOT CHECK THE VALIDITY OF ITS INPUT ARGUMENT.
;	ENTRY	A= INTEGER, RANGE 0 TO F
;	EXIT	A= ASCII CHARACTER.
;		C= A
;	CALLS	NONE.
; DESTROYS: AF

	AND	0FH
	ADD	A,90H	;SET UP A SO THAT A-F CAUSE A CARRY
	DAA		;ADJUST CONTENTS OF A REGISTER
	ADC	A,40H	;ADD IN CARRY AND ADJUST UPPER 4 BITS
	DAA		;ADJUST CONTENTS OF A REGISTER AGAIN
	MOV	C,A
	RET

OCRLF:
	;OUTPUT CR,LF ON CONSOLE SCREEN
	LK	C,CR
	CALL	COUT
	LK	C,LF
	JMP	COUT

O2SP:
	;OUTPUT 2 SPACES ON CONSOLE
	CALL	OSP
OSP:
	LK	C,' '
	JMP	COUT

RLWA	=	*-1	;LWA OF ROM RESIDENT CODE
	MSG	'LENGTH OF THIS ROM IS = ',RLWA
	IF	RLWA > 0FFCH
.9	ERROR	CODE TOO LARGE..
	ENDIF

	org	0ffdh
SERNO:	ds	3
;
;	endx	BMUTIL2.asm
;	END	OCCROM9?.???
