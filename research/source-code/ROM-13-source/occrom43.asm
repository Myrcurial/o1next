	TITLE	'Hardware PIO function processors.'
CDEHL:	;Compare DE to HL as unsigned integers.
;	Entry	DE,HL set to values to compare
;	Exit	Zbit set if DE = HL
;		Cbit set if DE < HL.
;	Uses	AF.
	MOV	A,D
	CMP	H
	RNZ		;If D .ne. H
	MOV	A,E
	CMP	L
	RNZ		;if DE .ne. HL
	STC
	RET
	space	4,10
DELAY:	;'N' Milliseconds
;	Entry	A=Number of Milliseconds to delay
;		SCLFRE= (Freq/1000)/25
;	Exit	Time passed.

	Proc
	PUSH	BC
	MOV	C,A
:1:	LDK	A,SCLFRE
 
:2:	DEC	A	;(4 tics)
	MOV	B,B	;(4 tics)
	MOV	C,C	;(4 tics)
	JNZ	:2	;(10 tics) If 1 ms not elapsed
	DEC	C
	JNZ	:1	;If requested msec not done
	POP	BC	;restore registers
	RET

;SCLFRE:	=	2000/22	;Z80, 2mhz
;...defined in OCCTXT.ast
	space	4,32
FILLZ:	;Fill block of memory with byte value.
;	Entry	DE=LENGTH TO broadcast character
;		C =character TO broadcast
;		HL=FWA TO START broadcast
;	EXIT	FILL DONE
	LK	C,0	;FILL WITH ZERO
FILLC:	MOV	A,E
	OR	D
	RZ		; return here if broadcast 0 bytes
	STO	C,[hl]	; 1st byte
	DEC	DE
	MOV	A,E
	OR	D
	RZ		; return here if broadcast 1 byte
	MOV	B,D
	MOV	C,E	; BC := (count)
	MOV	D,H
	MOV	E,L
	INC	DE	; DE := HL + 1
	LDIR		; overlapping move
	RET
	space	4,10
ESTR:	;Output ENCODED string to console
;	Entry	DE=FWA of source
	OR	A		;clear cbit
	LD	A,[de]
	RRC			;normalize char
	PUSH	AF
	AND	07Fh
	MOV	C,A
	CALL	CO		;output it
	INC	DE
	POP	AF
	JRNC	ESTR		;if not done
	RET
	page
.old	IF	FALSE
FVIO:	;Fill video memory with fixed data
;	Entry	C= data to broadcast
;	NOTE: Interrupts MUST be disabled..
	proc
	LDK	HL,FWAVM
	LDK	DE,LVMEM
	PUSH HL ! PUSH DE
	CALL	FILLC		;clear main vio
	POP  DE ! POP  HL

.mac	IF	RSIZE = 64
	ENADIM
	LDK	C,0		;clear 9th bit
:2:	MOV	A,D		;fill 9th bit memory
	OR	E
	JRZ	:4		;if done
	STO	C,[hl]
	INC	HL
	DEC	DE
	JR	:2		;loop

:4:	DISDIM
.mac	ENDIF

	RET
.old	ENDIF
	space	4,10
SPAO:	;Set PIA for output
	LDK	A,03h		;CRA1-0, Interrupt inputs CA1
	STO	A,H.VIO+1	;set data direction
	LDK	A,0FFh
	STO	A,H.VIO		;set all A lines as output
	LDK	A,0
	STO	A,H.VIO+3
	LDK	A,0FFh
	STO	A,H.VIO+2	;set all B lines as output
	RET
	space	4,10
OPAD:	;Output data to pia A register
;	Entry	C= data
;	Exit	PIAAD = new value
	LDK	A,4+3
	STO	A,H.VIO+1
	MOV	A,C
	STO	A,PIAAD
	STO	A,H.VIO		;send data
	RET
	space	4,10
OPBD:	;Output data to pia B register
;	PIA definition.
;	  7  6  5  4  3  2  1  0
;	+--+--+--+--+--+--+--+--+
;	|D1|D0|^G| vert  offset |
;	+--+--+--+--+--+--+--+--+
;
;	Entry	C= data
;	Exit	PIABD = new value
	LDK	A,4
	STO	A,H.VIO+3
	MOV	A,C
	STO	A,PIABD
	STO	A,H.VIO+2	;send data
	RET
	TITLE	'BMIEEE.ASM  -  IEEE-488 INTERFACE.'
;     +---------------------------------------+
;     | ENTERED 05/01/81 FROM TNW XEROX, SEH. |
;     +---------------------------------------+

;
;LAST EDITED AT 09:29 ON 11 NOV 80
;
;THERE ARE FOUR COMMANDS TO THE 6821
;
;	00	PERIPHERAL/DIRECTION REGISTER A		CPDRA
;	01	CONTROL REGISTER A			CCRA
;	10	PERIPHERAL/DIRECTION REGISTER B		CPDRB
;	11	CONTROL REGISTER B			CCRB
;
;BIT 2 OF THE CONTROL REGISTER (A AND B) ALLOWS SELECTION OF EITHER
;A PERIPHERAL INTERFACE REGISTER OR A DATA DIRECTION REGISTER.
;A "1" IN BIT 2 SELECTS THE PERIPHERAL REGISTER.
;
;THE TWO DATA DIRECTION REGISTERS ALLOW CONTROL OF THE DIRECTION
;OF DATA THROUGH EACH CORRESPONDING PERIPHERAL DATA LINE.
;A DATA DIRECTION REGISTER BIT SET AT "0" CONFIGURES
;THE CORRESPONDING PERIPHERAL DATA LINE AS AN INPUT.
;
;A RESET AT POWER UP HAS THE EFFECT OF ZEROING ALL PIA REGISTERS.
;THIS WILL SET PA0-PA7, PB0-PB7, CA2, AND CB2 AS INPUTS,
;AND ALL INTERRUPTS DISABLED.
;SIGNALS ATN, REN, AND IFC WILL BE DRIVEN LOW
;UNTIL INITIALIZED BY SOFTWARE.
;
;DATA DIRECTION IS ALWAYS SET FOR OUTPUT FOR THE DATA REGISTER.
;DATA MUST BE SET TO ALL ONES WHEN INPUTTING.
;THE INTERFACE IS IN SOURCE HANDSHAKE MODE IF DATA ENABLE (PB0)
;IS SET TO "0", AND IN ACCEPTOR HANDSHAKE MODE IF SET TO "1".
;WHEN SWITCHING FROM SOURCE TO ACCEPTOR HANDSHAKE,
;ATN WILL ALWAYS BE LOW.
;TAKE CONTROL CAN ONLY BE CALLED FOLLOWING A GO TO STANDBY.
;AFTER A FATAL ERROR, PERFORM AN IFC RESET.
;
;STANDARD VALUES USED:
;
;CCRA	0011(IFC)(DIR)10
;
;CCRB	0011(REN)(DIR)00
;
;CPDRA	SOURCE		DIRECTION	1111_1111
;			DATA		DATA
;
;CPDRA	ACCEPTOR	DIRECTION	1111_1111
;			DATA		1111_1111
;
;CPDRB	SOURCE		DIRECTION	0011_1111
;			DATA		000A_0010	;A = ATN
;
;CPDRB	ACCEPTOR	DIRECTION	1101_0111
;			DATA		0100_0101
	PAGE
;PIA SIGNAL DEFINITIONS:
;ALL SIGNALS ARE LOW ON THE IEEE BUS WHEN PIA REGISTER CONTAINS "1".
;
;	PA0	DIO 1
;	PA1	DIO 2
;	PA2	DIO 3
;	PA3	DIO 4
;	PA4	DIO 5
;	PA5	DIO 6
;	PA6	DIO 7
;	PA7	DIO 8
;
;	CA1	SRQ
;	CA2	IFC
;
;	PB0	ENABLE DATA OUT		(ENABLED WHEN "0")
;	PB1	ENABLE NDAC/NRFD	(ENABLED WHEN "0")
;	PB2	ENABLE EOI/DAV		(ENABLED WHEN "0")
;	PB3	EOI
;	PB4	ATN
;	PB5	DAV
;	PB6	NDAC
;	PB7	NRFD
;
;	CB1	NOT USED
;	CB2	REN
;
;CONTROL WORD FORMAT
;
;[  7  ][  6  ][  5  ][  4  ][  3  ][  2  ][  1  ][  0  ]
;
;[IRQA1][IRQA2][    CA2 CONTROL    ][ DDRA][ CA1 CONTROL]
;[IRQB1][IRQB2][    CB2 CONTROL    ][ DDRB][ CB1 CONTROL]
;
;	IRQA1	0	INTERRUPT FLAG SET BY FALL OF SRQ
;	IRQA2	0	NOT USED
;	CA2	110	SET IFC HIGH
;		111	SET IFC LOW
;	DDRA	0	R/W DATA DIRECTION REGISTER A
;		1	R/W PERIPHERAL REGISTER A
;	CA1	10	SET IRQA1 HIGH ON RISE OF SRQ
;
;	IRQB1	0	NOT USED
;	IRQB2	0	NOT USED
;	CB2	110	SET REN HIGH
;		111	SET REN LOW
;	DDRB	0	R/W DATA DIRECTION REGISTER B
;		1	R/W PERIPHERAL REGISTER B
;	CB1	00	NOT USED
	PAGE
;BIOS CALL 1:	CONTROL OUT
;
;	CAN BE CALLED WHILE IN ANY STATE.
;
;	EXITS IN THE CONTROLLER STANDBY STATE (ATN HIGH),
;	SOURCE HANDSHAKE MODE
;
;PARAMETER PASSED IN REGISTER C:
;
;	BIT 0	IF "1", THE IFC SIGNAL IS SET LOW FOR 100 MICRO-SEC
;		AND ALL PIA SIGNALS ARE INITIALIZED
;
;	BIT 2 1
;	    0 X	NO ACTION
;	    1 0 SETS REN HIGH
;	    1 1 SETS REN LOW
;
IE.CO:	PROC
	PUSH	AF
	PUSH	HL
	BIT	0,C		;CHECK IFC SUB-COMMAND
	JRZ	:B1C20

;INITIALIZE ALL IEEE-488 SIGNALS
	LK	HL,CCRA
	STO	0011_1010B,[HL]	;ENABLE SRQ AND SET IFC-OUT LOW
	LK	A,1111_1111B	;DIRECT DATA OUT
	STO	A,CPDRA
	STO	0011_1110B,[HL]
	XOR	A		;SET DATA TO ZERO
	STO	A,CPDRA
	LK	HL,CCRB
	STO	0011_0000B,[HL]	;SET REN-OUT HIGH
	LK	A,0011_1111B	;DIRECTION FOR SOURCE HANDSHAKE
	STO	A,CPDRB
	STO	0011_0100B,[HL]
	LK	A,0000_0010B	;VALUES FOR SOURCE HANDSHAKE
	STO	A,CPDRB

;LEAVE IFC LOW FOR 100 MICRO-SEC
	LK	A,25		;DELAY 100 MICRO-SEC
:B1C10:	DEC	A
	JRNZ	:B1C10
	LK	A,0011_0110B	;SET IFC HIGH
	STO	A,CCRA
:B1C20:	BIT	2,C		;CHECK REN SUB-COMMAND
	JRZ	:B1C40

;SET/CLEAR REN
	LK	A,0011_0000B
	BIT	1,C
	JRZ	:B1C30
	LK	A,0011_1000B
:B1C30:	STO	A,CCRB
:B1C40:	POP	HL
	POP	AF
	RET
	PAGE
;BIOS CALL 2:	STATUS IN
;
;	CAN BE CALLED ONLY WHILE IN SOURCE HANDSHAKE MODE.
;
;BIT 0 OF REGISTER A SET IF SRQ IS LOW
;
IE.SI:	PROC
	PUSH	HL
	LD	A,CPDRA		;CLEAR IRQA1
	LK	HL,CPDRB	;PULSE ENABLE ndac/nrfd
	CBIT	1,[HL]
	SBIT	1,[HL]
	LD	A,CCRA		;SET SRQ VALUE IN A
	AND	1000_0000B
	RLC	A
	POP	HL
	RET
	SPACE	4,14
;BIOS CALL 3: GO TO STANDBY
;
;	CAN BE CALLED ONLY WHILE IN SOURCE HANDSHAKE MODE
;
;NO PARAMETERS PASSED
;
IE.GTS:	PROC
	PUSH	AF
	LK	A,0000_0010B	;SET ATN HIGH
	STO	A,CPDRB
	XOR	A		;FLOAT DATA BUS
	STO	A,CPDRA
	POP	AF
	RET
	PAGE
;BIOS CALL 4:	TAKE CONTROL
;
;	CAN BE CALLED ONLY WHILE IN THE CONTROLLER STANDBY STATE
;		(ATN HIGH).
;
;	EXITS IN THE CONTROLLER ACTIVE STATE (ATN LOW),
;	SOURCE HANDSHAKE MODE.
;
;BIT 0 OF REGISTER C SET TO TAKE CONTROL ASYNCHRONOUS
;
;ERROR CODE RETURNED IN REGISTER A.
;
IE.TC:	PROC
	PUSH	HL
	LK	HL,CPDRB
	BIT	0,C
	JRNZ	:B4C30

;TAKE CONTROL SYNCHRONOUSLY
	STO	0000_0111B,[HL]	;DISABLE DRIVERS
	LD	A,CCRB
	CBIT	2,A
	STO	A,CCRB
	STO	1101_0111B,[HL]	;DIRECTION REGISTER
	SBIT	2,A
	STO	A,CCRB
	STO	1000_0101B,[HL]	;SET NRFD LOW
	LK	A,25
:B4C10:	BIT	5,[HL]
	JRZ	:B4C20		;DATA VALID HAS DROPPED
	DEC	A
	JRNZ	:B4C10		;WAIT 100 MICRO-SEC
	LK	A,1000_0001B	;SET DATA VALID TIMEOUT ERROR
	JR	:B4C40

:B4C20:	STO	1100_0101B,[HL]	;SET NDAC LOW
:B4C30:	SBIT	4,[HL]		;SET ATN LOW

;SET-UP FOR SOURCE HANDSHAKE
	LD	A,CCRB
	CBIT	2,A
	STO	A,CCRB
	STO	0011_1111B,[HL]	;DIRECTION REGISTER
	SBIT	2,A
	STO	A,CCRB
	STO	0001_0010B,[HL]	;CONTROL SIGNAL INITIAL VALUE
	XOR	A		;CLEAR ERROR CODE
:B4C40:	POP	HL
	RET
	PAGE
;BIOS CALL 5:	OUTPUT INTERFACE MESSAGE
;
;	CAN BE CALLED WHILE IN ANY MODE OR STATE
;
;	EXITS IN THE SOURCE HANDSHAKE MODE WITH ATN LOW.
;
;MULTI-LINE MESSAGE IN REGISTER C
;
;ERROR CODE RETURNED IN REGISTER A
;
IE.OIM:	PROC
	PUSH	HL
	LK	HL,CPDRB
	SBIT	4,[HL]		;SET ATN LOW
	BIT	0,[HL]
	JRZ	IE.SHK

;SET-UP FOR SOURCE HANDSHAKE
	STO	0001_0111B,[HL]	;DISABLE DRIVERS
	LD	A,CCRB
	CBIT	2,A
	STO	A,CCRB
	STO	0011_1111B,[HL]	;DIRECTION REGISTER
	SBIT	2,A
	STO	A,CCRB
	XOR	A		;FLOAT EXTERNAL DATA BUS
	STO	A,CPDRA
	STO	0001_0010B,[HL]	;CONTROL SIGNAL INITIAL VALUE
	JR	IE.SHK
	PAGE
;BIOS CALL 6:	OUTPUT DEVICE MESSAGE
;
;	CAN BE CALLED ONLY WHILE IN THE SOURCE HANDSHAKE MODE
;	WITH ATN HIGH OR LOW.
;
;	EXITS IN THE SOURCE HANDSHAKE MODE WITH ATN HIGH.
;
;MULTI-LINE MESSAGE IN REGISTER C
;EOI REQUEST IN REGISTER B
;
;ERROR CODE RETURNED IN REGISTER A
;
IE.ODM:	PROC
	PUSH	HL
	LK	HL,CPDRB
	CBIT	4,[HL]		;SET ATN HIGH
	BIT	0,B		;CHECK IF EOI REQUESTED
	JRZ	IE.SHK
	SBIT	3,[HL]
;PERFORM SOURCE HANDSHAKE
IE.SHK:	BIT	5,[HL]		;
	JRNZ	:B6C50		;DAC TIMEOUT RE-ENTRY
	MOV	A,C		;PLACE DATA ON BUS
	STO	A,CPDRA
	LK	A,10
:B6C20:	BIT	7,[HL]
	JRZ	:B6C30		;READY FOR DATA
	DEC	A
	JRNZ	:B6C20		;WAIT FOR 100 MICRO-SEC
	LK	A,1000_0010B	;SET RFD TIMEOUT ERROR
	JR	:B6C80

:B6C30:	BIT	6,[HL]
	JRNZ	:B6C40		;DATA ACCEPTED LOW
	LK	A,1000_0001B	;SET DEVICE NOT PRESENT ERROR
	JR	:B6C80

:B6C40:	SBIT	5,[HL]		;SET DAV LOW
:B6C50:	LK	A,255
:B6C60:	BIT	6,[HL]
	JRZ	:B6C70		;DATA ACCEPTED
	DEC	A
	JRNZ	:B6C60		;WAIT 1000 MICRO-SEC
	LK	A,1000_0100B	;SET DAC TIMEOUT ERROR
	JR	:B6C80

:B6C70:	CBIT	5,[HL]		;SET DAV HIGH
	CBIT	3,[HL]		;SET EOI HIGH
	XOR	A		;REMOVE DATA FROM BUS
	STO	A,CPDRA
:B6C80:	POP	HL
	RET
	PAGE
;BIOS CALL 7:	INPUT DEVICE MESSAGE
;
;	CAN BE CALLED WHILE IN ANY MODE OR STATE
;
;	EXITS IN THE ACCEPTOR HANDSHAKE MODE WITH ATN HIGH.
;
;DEVICE MESSAGE RETURNED IN BOTH REGISTERS A AND H
;ERROR CODE RETURNED IN REGISTER L
;
IE.IDM:	PROC
	PUSH	DE
	EX	DE,HL		;SAVE RE-ENTRY DATA
	LK	HL,CPDRB
	BIT	0,[HL]
	JRNZ	:B7C10

;SET-UP FOR ACCEPTOR HANDSHAKE
	STO	0001_0111B,[HL]	;DISABLE DRIVERS
	LD	A,CCRB
	CBIT	2,A
	STO	A,CCRB
	STO	1101_0111B,[HL]	;DIRECTION REGISTER
	SBIT	2,A
	STO	A,CCRB
	LK	A,1111_1111B	;FLOAT INTERNAL DATA BUS
	STO	A,CPDRA
	STO	0101_0101B,[HL]	;CONTROL SIGNALS INITIAL VALUE
	STO	0100_0101B,[HL]	;SET ATN HIGH

;PERFORM ACCEPTOR HANDSHAKE
:B7C10:	BIT	6,[HL]
	JRZ	:B7C50		;DATA INVALID TIMEOUT ERROR RE-ENTRY
	CBIT	7,[HL]		;SET NRFD HIGH
	LK	A,10
:B7C20:	BIT	5,[HL]
	JRNZ	:B7C30		;DATA VALID
	DEC	A
	JRNZ	:B7C20		;WAIT 100 MICRO-SEC
	LK	DE,1000_0010B	;SET DATA VALID TIMEOUT ERROR
	JR	:B7C80

:B7C30:	SBIT	7,[HL]		;SET NRFD LOW
	LD	A,CPDRA		;READ DATA
	MOV	D,A
	LK	E,0		;READ EOI
	BIT	3,[HL]
	JRZ	:B7C40
	LK	E,1
:B7C40:	CBIT	6,[HL]		;SET NDAC HIGH
:B7C50:	LK	A,255
:B7C60:	BIT	5,[HL]
	JRZ	:B7C70		;DATA VALID DROPPED
	DEC	A
	JRNZ	:B7C60		;WAIT 1000 MICRO-SEC
	SBIT	2,E		;SET DATA INVALID TIMEOUT ERROR
	SBIT	7,E
	JR	:B7C80

:B7C70:	SBIT	6,[HL]		;SET NDAC LOW
:B7C80:	EX	DE,HL		;MOVE RESULTS TO REGISTERS A AND HL
	MOV	A,H
	POP	DE
	RET
	SPACE	4,21
;BIOS CALL 8:	PARALLEL POLL
;
;	CAN BE CALLED ONLY WHILE IN THE SOURCE HANDSHAKE MODE
;	WITH ATN HIGH OR LOW.
;
;	EXITS IN THE SOURCE HANDSHAKE MODE WITH ATN LOW.
;
;PARALLEL POLL VALUE RETURNED IN A.
;
IE.PP:	PROC
	PUSH	HL
	LK	HL,CPDRA
	LK	A,0001_1011B	;FORM PARALLEL POLL
	STO	A,CPDRB
	STO	1111_1111B,[HL]	;FLOAT INTERNAL DATA BUS
	LD	A,[HL]		;READ PARALLEL POLL DATA
	STO	0,[HL]		;RE-STORE SOURCE HANDSHAKE MODE
	LK	HL,CPDRB
	STO	0001_0010B,[HL]
	POP	HL
	RET

;	END	OCCROM4?.???
